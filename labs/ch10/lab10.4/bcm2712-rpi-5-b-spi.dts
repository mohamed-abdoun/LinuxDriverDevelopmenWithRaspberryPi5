// SPDX-License-Identifier: GPL-2.0
/dts-v1/;
/plugin/;

/ {
    compatible = "raspberrypi,5-model-b", "brcm,bcm2712";
    
    fragment@0 {
        target = <&spidev0>;
        __overlay__ {
            compatible = "arrow,adxl345";
            spi-max-frequency = <5000000>;
            spi-cpol;
            spi-cpha;
            reg = <0>;
            pinctrl-names = "default";
            pinctrl-0 = <&accel_int_pin>;
            gpios = <&rp1_gpio 23 0>;
            interrupt-parent = <&rp1_gpio>;
            interrupts = <23 1>;
            status = "okay";
        };
    };
};
